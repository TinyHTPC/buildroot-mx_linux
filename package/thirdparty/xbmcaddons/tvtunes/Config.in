## package/thirdparty/xbmcaddons/tvtunes/Config.in
```kconfig
config BR2_PACKAGE_XBMC_ADDON_TVTUNES
    bool "script.tvtunes"
    default n
    help
      Get and play your Movie and TV shows Themes
```

## package/thirdparty/xbmcaddons/videolanguage/Config.in
```kconfig
config BR2_PACKAGE_XBMC_ADDON_VIDEOLANGUAGE
    bool "script.videolanguge"
    default n
    help
      This script makes it possible to show all audio and subtitle languages of a video file in the video info dialog.
```

## package/thirdparty/xbmcaddons/xbmcbackup/Config.in
```kconfig
config BR2_PACKAGE_XBMC_ADDON_XBMCBACKUP
    bool "script.xbmcbackup"
    default n
    help
      Backup and restore your XBMC database and configuration files in the event of a crash or file corruption.
```

## package/thirdparty/xbmcaddons/xbmcswift2/Config.in
```kconfig
config BR2_PACKAGE_XBMC_ADDON_XBMCSWIFT2
    bool "script.module.xbmcswift2"
    default n
    help
      xbmcswift2 for addon development
```

## package/thirdparty/xbmcaddons/youtube/Config.in
```kconfig
config BR2_PACKAGE_XBMC_ADDON_YOUTUBE
    bool "plugin.video.youtube"
    default n
    help
      Youtube XBMC plugin
```

## package/thirdparty/xbmcskins/Config.in
```kconfig
menu "XBMC skins"
    depends on BR2_PACKAGE_XBMC

comment "XBMC skins"

source "package/thirdparty/xbmcskins/tlbb/Config.in"

endmenu
```

## package/thirdparty/xbmcskins/tlbb/Config.in
```kconfig
config BR2_PACKAGE_XBMC_SKIN_TLBB
depends on BR2_PACKAGE_XBMC
        bool "TLBB"
```
