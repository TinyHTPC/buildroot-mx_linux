## package/thirdparty/tinyos/Config.in
```kconfig
config BR2_PACKAGE_XBMC_ADDON_TINYOS
    bool "TinyOS"
    help
      Xbmc TinyOS Addon
```

## package/thirdparty/xbmcaddons/Config.in
```kconfig
menu "XBMC addons"
    depends on BR2_PACKAGE_XBMC

comment "XBMC services"

source "package/thirdparty/xbmcaddons/opensubtitles/Config.in"
source "package/thirdparty/xbmcaddons/weather_underground/Config.in"

comment "XBMC scripts"

source "package/thirdparty/xbmcaddons/nm/Config.in"
source "package/thirdparty/xbmcaddons/hdtrailers_net/Config.in"
source "package/thirdparty/xbmcaddons/tlbbinstaller/Config.in"
source "package/thirdparty/xbmcaddons/tlbbwizard/Config.in"
source "package/thirdparty/xbmcaddons/tlbbrepo/Config.in"
source "package/thirdparty/xbmcaddons/artistslideshow/Config.in"
source "package/thirdparty/xbmcaddons/artwork_downloader/Config.in"
source "package/thirdparty/xbmcaddons/plugincache/Config.in"
source "package/thirdparty/xbmcaddons/favourites/Config.in"
source "package/thirdparty/xbmcaddons/globalsearch/Config.in"
source "package/thirdparty/xbmcaddons/libraryeditor/Config.in"
source "package/thirdparty/xbmcaddons/beautifulsoup/Config.in"
source "package/thirdparty/xbmcaddons/elementtree/Config.in"
source "package/thirdparty/xbmcaddons/mechanize/Config.in"
source "package/thirdparty/xbmcaddons/requests/Config.in"
source "package/thirdparty/xbmcaddons/requests2/Config.in"
source "package/thirdparty/xbmcaddons/simple_downloader/Config.in"
source "package/thirdparty/xbmcaddons/simplejson/Config.in"
source "package/thirdparty/xbmcaddons/xbmcswift2/Config.in"
source "package/thirdparty/xbmcaddons/playalbum/Config.in"
source "package/thirdparty/xbmcaddons/nextaired/Config.in"
source "package/thirdparty/xbmcaddons/tvtunes/Config.in"
source "package/thirdparty/xbmcaddons/debuglog/Config.in"
source "package/thirdparty/xbmcaddons/xbmcbackup/Config.in"
source "package/thirdparty/xbmcaddons/youtube/Config.in"
source "package/thirdparty/xbmcaddons/parsedom/Config.in"
source "package/thirdparty/xbmcaddons/extendedinfo/Config.in"
source "package/thirdparty/xbmcaddons/metadata/Config.in"
source "package/thirdparty/xbmcaddons/videolanguage/Config.in"

endmenu
```

## package/thirdparty/xbmcaddons/artistslideshow/Config.in
```kconfig
config BR2_PACKAGE_XBMC_ADDON_ARTISTSLIDESHOW
    bool "script.artistslideshow"
    default n
    help
      Download images and additional info of the currently playing artist
```

## package/thirdparty/xbmcaddons/artwork_downloader/Config.in
```kconfig
config BR2_PACKAGE_XBMC_ADDON_ARTWORK_DOWNLOADER
    bool "script.artwork.downloader"
    default n
    help
      Downloads Artwork for TV shows, Movies and Musicvideos in your library
```

## package/thirdparty/xbmcaddons/beautifulsoup/Config.in
```kconfig
config BR2_PACKAGE_XBMC_ADDON_BEAUTIFULSOUP
    bool "script.module.beautifulsoup"
    default n
    help
      HTML/XML parser for quick-turnaround applications like screen-scraping
```

## package/thirdparty/xbmcaddons/debuglog/Config.in
```kconfig
config BR2_PACKAGE_XBMC_ADDON_DEBUGLOG
    bool "script.xbmc.debug.log"
    default n
    help
      Uploads your logs to xbmclogs.com
```

## package/thirdparty/xbmcaddons/elementtree/Config.in
```kconfig
config BR2_PACKAGE_XBMC_ADDON_ELEMENTTREE
    bool "script.module.elementtree"
    default n
    help
      Elementtree XML parser
```

## package/thirdparty/xbmcaddons/extendedinfo/Config.in
```kconfig
config BR2_PACKAGE_XBMC_ADDON_EXTENDEDINFO
    bool "script.extendedinfo"
    default n
    help
      This script makes it possible to get additional info for lot of different media types.
```

## package/thirdparty/xbmcaddons/favourites/Config.in
```kconfig
config BR2_PACKAGE_XBMC_ADDON_FAVOURITES
    bool "script.favourites"
    default n
    help
      Fetches item from your xbmc favourites to populate Home menu/submenu with custom buttons.
```

## package/thirdparty/xbmcaddons/globalsearch/Config.in
```kconfig
config BR2_PACKAGE_XBMC_ADDON_GLOBALSEARCH
    bool "script.globalsearch"
    default n
    help
      This addon can find any item in your video and music library.
```

## package/thirdparty/xbmcaddons/hdtrailers_net/Config.in
```kconfig
config BR2_PACKAGE_XBMC_ADDON_HDTRAILERS_NET
    bool "plugin.video.hdtrailers_net"
    default n
    help
      Trailer and Clips from several sources in HD
```

## package/thirdparty/xbmcaddons/libraryeditor/Config.in
```kconfig
config BR2_PACKAGE_XBMC_ADDON_LIBRARYEDITOR
    bool "script.libraryeditor"
    default n
    help
      This script makes it possible to edit movie details manually from within XBMC. Needs Skin Support
```

## package/thirdparty/xbmcaddons/mechanize/Config.in
```kconfig
config BR2_PACKAGE_XBMC_ADDON_MECHANIZE
    bool "script.module.mechanize"
    default n
    help
      Stateful programmatic web browsing in Python, after Andy Lester’s Perl module WWW::Mechanize.
```

## package/thirdparty/xbmcaddons/metadata/Config.in
```kconfig
config BR2_PACKAGE_XBMC_ADDON_METADATA
    bool "script.metadata"
    default n
    help
      With this script you can view meta information such as biography, birthday or filmography of an actor, director or writer. It's possible to show information about all movies even if they are not available in the local movie library.
```

## package/thirdparty/xbmcaddons/nextaired/Config.in
```kconfig
config BR2_PACKAGE_XBMC_ADDON_NEXTAIRED
    bool "script.tv.show.next.aired"
    default n
    help
      Get info for TV Shows Next Aired.
```

## package/thirdparty/xbmcaddons/parsedom/Config.in
```kconfig
config BR2_PACKAGE_XBMC_ADDON_PARSEDOM
    bool "script.module.parsedom"
    default n
    help
      Parsedom for xbmc plugins.
```

## package/thirdparty/xbmcaddons/playalbum/Config.in
```kconfig
config BR2_PACKAGE_XBMC_ADDON_PLAYALBUM
    bool "script.playalbum"
    default n
    help
      Script will play a full album when executed in the album info dialog.
```

## package/thirdparty/xbmcaddons/plugincache/Config.in
```kconfig
config BR2_PACKAGE_XBMC_ADDON_PLUGINCACHE
    bool "script.common.plugin.cache"
    default n
    help
      Common caching api for xbmc plugins
```

## package/thirdparty/xbmcaddons/requests/Config.in
```kconfig
config BR2_PACKAGE_XBMC_ADDON_REQUESTS
    bool "script.module.requests"
    default n
    help
      Python HTTP for Humans
```

## package/thirdparty/xbmcaddons/requests2/Config.in
```kconfig
config BR2_PACKAGE_XBMC_ADDON_REQUESTS2
    bool "script.module.requests2"
    default n
    help
      Python HTTP for Humans
```

## package/thirdparty/xbmcaddons/simple_downloader/Config.in
```kconfig
config BR2_PACKAGE_XBMC_ADDON_SIMPLE_DOWNLOADER
    bool "script.module.simple.downloader"
    default n
    help
      Simple downloader for xbmc plugins.
```

## package/thirdparty/xbmcaddons/simplejson/Config.in
```kconfig
config BR2_PACKAGE_XBMC_ADDON_SIMPLEJSON
    bool "script.module.simplejson"
    default n
    help
      Simple, fast, extensible JSON encoder/decoder for Python
```

## package/thirdparty/xbmcaddons/tlbbinstaller/Config.in
```kconfig
config BR2_PACKAGE_XBMC_ADDON_TLBBINSTALLER
    bool "plugin.video.tlbbinstaller"
    default n
    help
      TLBB quick keyword installer
```

## package/thirdparty/xbmcaddons/tlbbrepo/Config.in
```kconfig
config BR2_PACKAGE_XBMC_ADDON_TLBBREPO
    bool "repository.tlbb"
    default n
    help
      TLBB repository
```

## package/thirdparty/xbmcaddons/tlbbwizard/Config.in
```kconfig
config BR2_PACKAGE_XBMC_ADDON_TLBBWIZARD
    bool "plugin.video.tlbbwizard"
    default n
    help
      TLBB quick addon packages installer
```
